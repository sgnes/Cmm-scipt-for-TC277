dialog.EXecute BTNRELOAD
wait 1.ms
dialog.end

enddo